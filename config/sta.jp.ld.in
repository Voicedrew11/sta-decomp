/* Linker script for SLPS_252.17 (Japanese retail), GNU ld 2.10.
 * Only .text has a fixed address (the load address); every later section
 * follows the one before it, 0x80-aligned, and _gp is the small data base
 * (.sdata + 0x7FF0): retail's addresses come out, and they follow when the
 * image shifts. tools/gen_ninja.py expands
 * each @INPUTS:<section>@ into that section's inputs in link order and writes
 * build/sta.ld (ld 2.10 has no INCLUDE inside an output section).
 * The retail ELF was linked by mwldps2 into one PROGBITS blob; the section
 * boundaries are the ones recorded in config/sta.jp.yaml. mwldps2 placed
 * every unit's .data and then every unit's .rodata in one range, so both go
 * into .data here. */
ENTRY(_start)
SECTIONS
{
    .text    0x00100000 : {
        @INPUTS:text@
    }
    .data    ALIGN(0x80) : {
        @INPUTS:data@
        @INPUTS:rodata@
    }
    .sdata   ALIGN(0x80) : { *(.sdata) }
    _gp = ADDR(.sdata) + 0x7FF0;
    .sbss    ALIGN(0x80) (NOLOAD) : { *(.sbss) *(EXCLUDE_FILE(*sbrkr.c.o) .scommon) }
    _fbss = ADDR(.sbss);
    /* libc's errno (a small common of sbrkr.c, which ld would put in
       .scommon) follows every object's .bss, as retail has it; the end is
       0x80-aligned (0x4BE180) */
    .bss     ALIGN(0x80) (NOLOAD) : { *(.bss) *(COMMON) *(.scommon) . = ALIGN(0x80); }
    _end = .;

    /DISCARD/ : { *(.text.iastub) *(.reginfo) *(.mwcats) *(.mdebug) *(.pdr) *(.comment) *(.gnu.attributes) *(.MIPS.abiflags) }
}
